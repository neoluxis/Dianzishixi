//-----------------------------------------------------------------------------//
//---------------心率仪C51程序框架---by tjx------------------------------------//
//---------------------2022.12-------------------------------------------------//
//------------------crystal=6MHz-----------------------------------------------//
//-----------------------------------------------------------------------------//

//-----------------------------------------------------------------------------//
// 包含头文件、定义各个接口-----------------------------------------------------//
//-----------------------------------------------------------------------------//
#include <AT89X52.H>
#define uint unsigned int   // 定义一下方便编程
#define uchar unsigned char // 定义一下方便编程
#define keystart P1_0       // 定义心率测量启动按键输入口------不按输入为1电平，按下输入为0电平
#define ledtest P3_4        // 定义测量指示灯控制口------------输出1电平灯不亮，输出0电平灯亮
#define signal P2_0         // 定义心跳信号输入口--------------根据心跳信号电平高低变化
#define keymodel P1_3       // 定义测量模式设置按键输入口------按下输入0电平，松开输入1电平
#define ledmodle P1_7       // 定义工作模式指示灯控制口--------输出1电平灯不亮，输出0电平灯亮，用来指示测量模式
#define baiwei P2_1         // 定义百位驱动口------------------百位数码管输出控制端，输出0电平对应的百位点亮，输出1电平对应的百位不亮
#define shiwei P2_4         // 定义十位驱动口------------------十位数码管输出控制端，输出0电平对应的十位点亮，输出1电平对应的十位不亮
#define gewei P2_7          // 定义个位驱动口------------------个位数码管输出控制端，输出0电平对应的个位点亮，输出1电平对应的个位不亮

#define SOUND_RESET P1_6 // 定义语音芯片复位口
#define SOUND_DATA P1_5  // 定义语音芯片数据口
#define SOUND_BUSY P1_4  // 定义语音芯片忙碌口
void sound_reset(void);
void speek(unsigned char num);
void speekone(void);
code uchar datab[] = {

    0xA0, //"0"
    0xAF, //"1"
    0x98, //"2"
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    0xFF, //??
    0xFF  //???

};

code uchar my_xuehao[10] = {2, 2, 0, 1, 4, 0, 0, 2, 1, 6};

uint heartrate = 0; // 定义心率值存储变量
uchar ge, shi, bai; // 定义心率计数三个位的显示值
uint i = 0;         // 定义全局变量，用于定时计数
uint time = 600;    // 定义计时时间，600次计时为1分钟
bit flag = 0;       // 定义时间标志位变量
bit fast = 0;       // 定义快速测量标志位变量
bit finish = 0;     // 定义测量完成标志位变量

uchar display_period = 5; // 一个显示周期的时间长度，单位为ms，5ms=5000us，与实习报告所测得的一致

//-----------------------------------------------------------------------------//
// 函数声明---------------------------------------------------------------------//
//-----------------------------------------------------------------------------//
void mcuint(void);         // 单片机初始化函数
void delay1ms(uint count); // 毫秒级延时函数
void measure(int);         // 心率测量函数   快速测量心率的函数自行考虑
int j = 0;

void display_sound(void);
void display_id(void)
{
  if (j >= 3)
  {
    heartrate = heartrate % 100;
  }
  heartrate = my_xuehao[j] + heartrate * 10;
  speek(my_xuehao[j]);
  j++;
  delay1ms(100);
}

void tell_rate(void)
{
  uint rate[3];
  uint hrate = heartrate;
  for (j = 0; hrate; j++, hrate /= 10)
  {
    rate[j] = hrate % 10;
  }
  for (j=2;j>=0;j--){
    speek(rate[j]);
  }
}

//-----------------------------------------------------------------------------//
// 主函数，开机初始化单片机，并显示2s的888，用于检测笔画是否接正确--------------//
//-----------------------------------------------------------------------------//
void main(void)
{
  mcuint();
  display_sound();
  heartrate = 000;
  while (1)
  {
    if (keymodel == 0) // 如果按下了测量模式设置按键
    {
      fast = ~fast;
      while (keymodel == 0)
        ; // 等待按键松开
    }
    measure(fast);
  }
}

//-----------------------------------------------------------------------------//
// 单片机初始化函数-------------------------------------------------------------//
//-----------------------------------------------------------------------------//
void mcuint(void)
{
  P0 = 0xFF;                                  // 使单片机上电后P0口都输出1
  P1 = 0xFF;                                  // 使单片机上电后P1口都输出1
  P2 = 0xFF;                                  // 使单片机上电后P2口都输出1
  P3 = 0xFF;                                  // 使单片机上电后P3口都输出1
  TMOD = 0x11;                                // 设定定时器T0、T1的工作模式为16位定时器
  TL0 = (65536 - display_period * 500) % 256; // 设定定时器T0的低8位初值---T0用于刷新数码管显示
  TH0 = (65536 - display_period * 500) / 256; // 设定定时器T0的高8位初值---T0用于刷新数码管显示
  TL1 = (65536 - 100 * 500) % 256;            // 设定定时器T1的低8位初值---100为100毫秒，1次计时100毫秒，600次就是1分钟
  TH1 = (65536 - 100 * 500) / 256;            // 设定定时器T1的高8位初值
  IE = 0x8A;                                  // 开总中断、定时器T0中断、定时器T1中断
  IP = 0x08;                                  // 设定中断优先级，定时器T1中断优先
  TR0 = 1;                                    // 开启定时器T0，数码管开始定时刷新显示
}

//-----------------------------------------------------------------------------//
// 延时1ms的函数----------------------------------------------------------------//
//-----------------------------------------------------------------------------//
void delay1ms(uint count)
{
  int m, n;
  for (m = 0; m < count; m++)
    for (n = 0; n < 59; n++)
      ;
}

//-----------------------------------------------------------------------------//
// T0中断服务函数，作用是每5ms扫描一次数码管------------------------------------//
//-----------------------------------------------------------------------------//
void timer0() interrupt 1
{
  TL0 = 0x3C;
  TH0 = 0xF6;
  // 假设每分钟跳135次	 ,heartrate=321
  bai = heartrate / 100;       // 计算百位数值
  shi = (heartrate / 10) % 10; // 计算十位数值
  ge = heartrate % 10;         // 计算个位数值

  // 以下三个语句为显示个位的数值
  P0 = datab[ge]; // 把各位显示数值的码值取出来给P0
  gewei = 0;      // P2_7=0; 相当于开启个位的电源
  delay1ms(1);
  gewei = 1; // P2_7=1; 相当于关闭个位的电源

  // 以下三个语句为显示十位的数值
  P0 = datab[shi]; // 把十位显示数值的码值取出来给P0
  shiwei = 0;      // P2_4=0; 相当于开启十位的电源
  delay1ms(1);
  shiwei = 1; // P2_4=1; 相当于关闭十位的电源

  // 以下三个语句为显示百位的数值
  P0 = datab[bai]; // 把百位显示数值的码值取出来给P0
  baiwei = 0;      // P2_1=0; 相当于开启百位的电源
  delay1ms(1);
  baiwei = 1; // P2_1=1; 相当于关闭百位的电源
}

//-----------------------------------------------------------------------------//
// T1中断函数，作用是1分钟计时，时间到置标志位为1------------------------------//
//-----------------------------------------------------------------------------//
void timer1() interrupt 3
{
  TL1 = 0xB0;
  TH1 = 0x3C;
  i++;
  if (i == time) // 如果计时时间到了，标志位置1
  {
    i = 0;    // 计数变量归0
    flag = 1; // 时间到标志位置1
  }
  if (finish)
  {
    if (i % 10 == 0)
      ledtest = !ledtest;
  }
}

//-----------------------------------------------------------------------------//
// 慢速测量心率函数-------------------------------------------------------------//
//-----------------------------------------------------------------------------//
void measure(int mod)
{
  if (mod)
  {
    ledmodle = 0;
    time = 40;
  }
  else
  {
    ledmodle = 1;
    time = 600;
  }
  if (keystart == 0)
  {
    finish = 0;    // 测量完成标志位清0
    heartrate = 0; // 心率值清0
    TR1 = 1;       // 开启定时器，开始60秒计时
    ledtest = 0;   // 点亮测量指示灯
    while (1)
    {
      if (signal == 0) // 如果心跳信号输入为0电平
      {
        heartrate++; // 心率值加1
        while (signal == 0)
          ; // 等待心跳信号变为1电平
      }
      if (flag == 1) // 如果时间到了
      {
        TR1 = 0;     // 关闭定时器
        ledtest = 1; // 熄灭测量指示灯
        flag = 0;    // 时间标志位清0
        break;       // 退出测量模式
      }
    }
    if (mod)
    {
      heartrate = heartrate * 12;
    }
    tell_rate();
    finish = 1; // 测量完成标志位置1
  }
}

void sound_reset(void)
{
  SOUND_RESET = 1;
  delay1ms(2);
  SOUND_RESET = 0;
  delay1ms(2);
}

void speek(unsigned char num)
{
  unsigned char i = 0;
  while (SOUND_BUSY == 0)
    ;
  sound_reset();
  if ((num >= 0) && (num <= 9))
  {
    for (i = 0; i < num + 2; i++)
    {
      SOUND_DATA = 1;
      delay1ms(1);
      SOUND_DATA = 0;
      delay1ms(1);
    }
  }
  else
  {
    for (i = 0; i < num; i++)
    {
      SOUND_DATA = 1;
      delay1ms(1);
      SOUND_DATA = 0;
      delay1ms(1);
    }
  }
}

void speekone(void)
{
  while (SOUND_BUSY == 0)
    ;
  speek(33);
}

void display_sound(void)
{
  P0 = 0x00;
  speek(26);
  speek(28);
  speek(2);
  speek(0);
  speek(2);
  speek(4);
  speek(17);
  speek(4);
  speek(18);
  speek(3);
  speek(19);
  speek(20);
  speek(3);
  speek(23);
  speek(29);
  speek(9);
  speek(14);
  speek(3);
  speek(12);
  speek(15);
  for (j = 0; j < 10; j++)
    speek(my_xuehao[j]);
}
